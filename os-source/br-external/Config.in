## os-source/br-external/Config.in
```kconfig
menu "Fusion OS packages"
	source "$BR2_EXTERNAL_FUSION_PATH/package/appstream/Config.in"
	source "$BR2_EXTERNAL_FUSION_PATH/package/ostree/Config.in"
	source "$BR2_EXTERNAL_FUSION_PATH/package/flatpak/Config.in"
	source "$BR2_EXTERNAL_FUSION_PATH/package/fusion-firmware-extra/Config.in"
endmenu
```

## os-source/br-external/package/appstream/Config.in
```kconfig
config BR2_PACKAGE_APPSTREAM
	bool "appstream"
	depends on !BR2_STATIC_LIBS # glib2
	depends on BR2_TOOLCHAIN_HAS_THREADS # glib2
	depends on BR2_USE_MMU # glib2
	depends on BR2_USE_WCHAR # glib2
	select BR2_PACKAGE_LIBGLIB2
	select BR2_PACKAGE_LIBCURL
	select BR2_PACKAGE_LIBXML2
	select BR2_PACKAGE_LIBYAML
	select BR2_PACKAGE_LIBXMLB
	help
	  AppStream: tools and libraries to work with software
	  component metadata. Required by Flatpak.

	  https://www.freedesktop.org/wiki/Distributions/AppStream/

comment "appstream needs a toolchain w/ wchar, threads, dynamic library"
	depends on BR2_USE_MMU
	depends on !BR2_USE_WCHAR || !BR2_TOOLCHAIN_HAS_THREADS || BR2_STATIC_LIBS
```

## os-source/br-external/package/flatpak/Config.in
```kconfig
config BR2_PACKAGE_FLATPAK
	bool "flatpak"
	depends on BR2_TOOLCHAIN_USES_GLIBC # ostree
	depends on !BR2_STATIC_LIBS
	depends on BR2_TOOLCHAIN_HAS_THREADS
	depends on BR2_USE_MMU
	depends on BR2_USE_WCHAR
	depends on BR2_PACKAGE_SYSTEMD
	select BR2_PACKAGE_OSTREE
	select BR2_PACKAGE_APPSTREAM
	select BR2_PACKAGE_LIBGLIB2
	select BR2_PACKAGE_LIBCAP
	select BR2_PACKAGE_LIBARCHIVE
	select BR2_PACKAGE_LIBCURL
	select BR2_PACKAGE_LIBXML2
	select BR2_PACKAGE_LIBFUSE3
	select BR2_PACKAGE_JSON_GLIB
	select BR2_PACKAGE_GDK_PIXBUF
	select BR2_PACKAGE_LIBGPGME
	select BR2_PACKAGE_LIBSECCOMP
	select BR2_PACKAGE_BUBBLEWRAP
	select BR2_PACKAGE_XDG_DBUS_PROXY
	select BR2_PACKAGE_ZSTD
	help
	  Flatpak: sandboxed application distribution. Lets Fusion OS
	  run Steam (with its own 32-bit runtime), Discord, Heroic and
	  Firefox from Flathub on a from-source base.

	  https://flatpak.org/

comment "flatpak needs systemd and a glibc toolchain w/ wchar, threads, dynamic library"
	depends on BR2_USE_MMU
	depends on !BR2_PACKAGE_SYSTEMD || !BR2_TOOLCHAIN_USES_GLIBC || \
		!BR2_USE_WCHAR || !BR2_TOOLCHAIN_HAS_THREADS || BR2_STATIC_LIBS
```

## os-source/br-external/package/fusion-firmware-extra/Config.in
```kconfig
config BR2_PACKAGE_FUSION_FIRMWARE_EXTRA
	bool "fusion-firmware-extra"
	help
	  Firmware that Buildroot's linux-firmware package has no option
	  for: Qualcomm Wi-Fi 6/6E/7 laptop cards (ath11k WCN6855/QCA6390/
	  QCA2066, ath12k WCN7850) and their Bluetooth parts. Taken from the
	  same upstream linux-firmware release as Buildroot's package.
```

## os-source/br-external/package/ostree/Config.in
```kconfig
config BR2_PACKAGE_OSTREE
	bool "ostree"
	depends on BR2_TOOLCHAIN_USES_GLIBC # libglnx assumptions
	depends on !BR2_STATIC_LIBS
	depends on BR2_TOOLCHAIN_HAS_THREADS
	depends on BR2_USE_MMU
	depends on BR2_USE_WCHAR
	select BR2_PACKAGE_LIBGLIB2
	select BR2_PACKAGE_XZ
	select BR2_PACKAGE_ZLIB
	select BR2_PACKAGE_E2FSPROGS
	select BR2_PACKAGE_LIBGPGME
	select BR2_PACKAGE_LIBCURL
	select BR2_PACKAGE_LIBARCHIVE
	select BR2_PACKAGE_UTIL_LINUX
	select BR2_PACKAGE_UTIL_LINUX_LIBMOUNT
	help
	  libostree: a library and tools for versioned, content-addressed
	  filesystem trees. Flatpak uses it to store and deploy apps.

	  https://ostreedev.github.io/ostree/

comment "ostree needs a glibc toolchain w/ wchar, threads, dynamic library"
	depends on BR2_USE_MMU
	depends on !BR2_TOOLCHAIN_USES_GLIBC || !BR2_USE_WCHAR || \
		!BR2_TOOLCHAIN_HAS_THREADS || BR2_STATIC_LIBS
```
